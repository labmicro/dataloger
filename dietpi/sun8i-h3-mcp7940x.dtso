/dts-v1/;
/plugin/;

/ {
    compatible = "allwinner,sun8i-h3";

    fragment@0 {
        target-path = "/aliases";

        __overlay__ {
            rtc = "/soc/rtc@1f00000";
        };
    };

    fragment@1 {
        target = <0xffffffff>;

        __overlay__ {
            status = "disabled";
        };
    };

    fragment@2 {
        target = <&i2c0>;
        __overlay__ {
            #address-cells = <1>;
            #size-cells = <0>;

            mcp7940x: mcp7940x@6f {
                compatible = "microchip,mcp7940x";
                reg = <0x6f>;
                status = "okay";
            };
        };
    };

    __fixups__ {
            rtc = "/fragment@1:target:0";
    };
};

